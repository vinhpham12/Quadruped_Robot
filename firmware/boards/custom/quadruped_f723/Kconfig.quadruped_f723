## firmware/boards/custom/quadruped_f723/Kconfig.quadruped_f723
```kconfig
# SPDX-License-Identifier: Apache-2.0

config BOARD_QUADRUPED_F723
	select SOC_STM32F723XX
```

## firmware/build/Kconfig/Kconfig.shield.defconfig
```kconfig
osource "/home/pham_vinh/Desktop/Quadruped_Robot/firmware/boards/shields/*/Kconfig.defconfig"
```

## firmware/build/Kconfig/arch/Kconfig
```kconfig
# Load arch Kconfig descriptions.
osource "/home/pham_vinh/Desktop/zephyr_project/zephyr/arch/x86/Kconfig"
osource "/home/pham_vinh/Desktop/zephyr_project/zephyr/arch/xtensa/Kconfig"
osource "/home/pham_vinh/Desktop/zephyr_project/zephyr/arch/sparc/Kconfig"
osource "/home/pham_vinh/Desktop/zephyr_project/zephyr/arch/riscv/Kconfig"
osource "/home/pham_vinh/Desktop/zephyr_project/zephyr/arch/posix/Kconfig"
osource "/home/pham_vinh/Desktop/zephyr_project/zephyr/arch/nios2/Kconfig"
osource "/home/pham_vinh/Desktop/zephyr_project/zephyr/arch/mips/Kconfig"
osource "/home/pham_vinh/Desktop/zephyr_project/zephyr/arch/arm64/Kconfig"
osource "/home/pham_vinh/Desktop/zephyr_project/zephyr/arch/arm/Kconfig"
osource "/home/pham_vinh/Desktop/zephyr_project/zephyr/arch/arc/Kconfig"
```

## firmware/build/Kconfig/soc/Kconfig.defconfig
```kconfig
# Load Zephyr SoC Kconfig defconfig.
osource "/home/pham_vinh/Desktop/zephyr_project/zephyr/soc/xlnx/zynqmp/Kconfig.defconfig"
osource "/home/pham_vinh/Desktop/zephyr_project/zephyr/soc/xlnx/zynq7000/Kconfig.defconfig"
osource "/home/pham_vinh/Desktop/zephyr_project/zephyr/soc/xen/Kconfig.defconfig"
osource "/home/pham_vinh/Desktop/zephyr_project/zephyr/soc/ti/simplelink/Kconfig.defconfig"
osource "/home/pham_vinh/Desktop/zephyr_project/zephyr/soc/ti/lm3s6965/Kconfig.defconfig"
osource "/home/pham_vinh/Desktop/zephyr_project/zephyr/soc/ti/k3/Kconfig.defconfig"
osource "/home/pham_vinh/Desktop/zephyr_project/zephyr/soc/telink/tlsr/Kconfig.defconfig"
osource "/home/pham_vinh/Desktop/zephyr_project/zephyr/soc/starfive/jh71xx/Kconfig.defconfig"
osource "/home/pham_vinh/Desktop/zephyr_project/zephyr/soc/st/stm32/Kconfig.defconfig"
osource "/home/pham_vinh/Desktop/zephyr_project/zephyr/soc/snps/qemu_arc/Kconfig.defconfig"
osource "/home/pham_vinh/Desktop/zephyr_project/zephyr/soc/snps/nsim/arc_v/Kconfig.defconfig"
osource "/home/pham_vinh/Desktop/zephyr_project/zephyr/soc/snps/nsim/arc_classic/Kconfig.defconfig"
osource "/home/pham_vinh/Desktop/zephyr_project/zephyr/soc/snps/hsdk4xd/Kconfig.defconfig"
osource "/home/pham_vinh/Desktop/zephyr_project/zephyr/soc/snps/hsdk/Kconfig.defconfig"
osource "/home/pham_vinh/Desktop/zephyr_project/zephyr/soc/snps/emsk/Kconfig.defconfig"
osource "/home/pham_vinh/Desktop/zephyr_project/zephyr/soc/snps/emsdp/Kconfig.defconfig"
osource "/home/pham_vinh/Desktop/zephyr_project/zephyr/soc/snps/arc_iot/Kconfig.defconfig"
osource "/home/pham_vinh/Desktop/zephyr_project/zephyr/soc/silabs/Kconfig.defconfig"
osource "/home/pham_vinh/Desktop/zephyr_project/zephyr/soc/sifive/sifive_freedom/Kconfig.defconfig"
osource "/home/pham_vinh/Desktop/zephyr_project/zephyr/soc/rockchip/Kconfig.defconfig"
osource "/home/pham_vinh/Desktop/zephyr_project/zephyr/soc/renode/riscv_virtual/Kconfig.defconfig"
osource "/home/pham_vinh/Desktop/zephyr_project/zephyr/soc/renesas/smartbond/Kconfig.defconfig"
osource "/home/pham_vinh/Desktop/zephyr_project/zephyr/soc/renesas/rzt2m/Kconfig.defconfig"
osource "/home/pham_vinh/Desktop/zephyr_project/zephyr/soc/renesas/rcar/Kconfig.defconfig"
osource "/home/pham_vinh/Desktop/zephyr_project/zephyr/soc/renesas/ra/Kconfig.defconfig"
osource "/home/pham_vinh/Desktop/zephyr_project/zephyr/soc/raspberrypi/Kconfig.defconfig"
osource "/home/pham_vinh/Desktop/zephyr_project/zephyr/soc/quicklogic/eos_s3/Kconfig.defconfig"
osource "/home/pham_vinh/Desktop/zephyr_project/zephyr/soc/qemu/virt_riscv/Kconfig.defconfig"
osource "/home/pham_vinh/Desktop/zephyr_project/zephyr/soc/qemu/malta/Kconfig.defconfig"
osource "/home/pham_vinh/Desktop/zephyr_project/zephyr/soc/openisa/rv32m1/Kconfig.defconfig"
osource "/home/pham_vinh/Desktop/zephyr_project/zephyr/soc/nxp/s32/Kconfig.defconfig"
osource "/home/pham_vinh/Desktop/zephyr_project/zephyr/soc/nxp/rw/Kconfig.defconfig"
osource "/home/pham_vinh/Desktop/zephyr_project/zephyr/soc/nxp/mcx/Kconfig.defconfig"
osource "/home/pham_vinh/Desktop/zephyr_project/zephyr/soc/nxp/lpc/Kconfig.defconfig"
osource "/home/pham_vinh/Desktop/zephyr_project/zephyr/soc/nxp/layerscape/Kconfig.defconfig"
osource "/home/pham_vinh/Desktop/zephyr_project/zephyr/soc/nxp/kinetis/Kconfig.defconfig"
osource "/home/pham_vinh/Desktop/zephyr_project/zephyr/soc/nxp/imxrt/Kconfig.defconfig"
osource "/home/pham_vinh/Desktop/zephyr_project/zephyr/soc/nxp/imx/Kconfig.defconfig"
osource "/home/pham_vinh/Desktop/zephyr_project/zephyr/soc/nuvoton/numicro/Kconfig.defconfig"
osource "/home/pham_vinh/Desktop/zephyr_project/zephyr/soc/nuvoton/numaker/Kconfig.defconfig"
osource "/home/pham_vinh/Desktop/zephyr_project/zephyr/soc/nuvoton/npcx/Kconfig.defconfig"
osource "/home/pham_vinh/Desktop/zephyr_project/zephyr/soc/nordic/Kconfig.defconfig"
osource "/home/pham_vinh/Desktop/zephyr_project/zephyr/soc/neorv32/Kconfig.defconfig"
osource "/home/pham_vinh/Desktop/zephyr_project/zephyr/soc/native/inf_clock/Kconfig.defconfig"
osource "/home/pham_vinh/Desktop/zephyr_project/zephyr/soc/microchip/miv/Kconfig.defconfig"
osource "/home/pham_vinh/Desktop/zephyr_project/zephyr/soc/microchip/mec/Kconfig.defconfig"
osource "/home/pham_vinh/Desktop/zephyr_project/zephyr/soc/mediatek/mtk_adsp/Kconfig.defconfig"
osource "/home/pham_vinh/Desktop/zephyr_project/zephyr/soc/lowrisc/opentitan/Kconfig.defconfig"
osource "/home/pham_vinh/Desktop/zephyr_project/zephyr/soc/litex/litex_vexriscv/Kconfig.defconfig"
osource "/home/pham_vinh/Desktop/zephyr_project/zephyr/soc/ite/ec/Kconfig.defconfig"
osource "/home/pham_vinh/Desktop/zephyr_project/zephyr/soc/intel/raptor_lake/Kconfig.defconfig"
osource "/home/pham_vinh/Desktop/zephyr_project/zephyr/soc/intel/lakemont/Kconfig.defconfig"
osource "/home/pham_vinh/Desktop/zephyr_project/zephyr/soc/intel/intel_socfpga_std/Kconfig.defconfig"
osource "/home/pham_vinh/Desktop/zephyr_project/zephyr/soc/intel/intel_socfpga/Kconfig.defconfig"
osource "/home/pham_vinh/Desktop/zephyr_project/zephyr/soc/intel/intel_niosv/Kconfig.defconfig"
osource "/home/pham_vinh/Desktop/zephyr_project/zephyr/soc/intel/intel_ish/Kconfig.defconfig"
osource "/home/pham_vinh/Desktop/zephyr_project/zephyr/soc/intel/intel_adsp/Kconfig.defconfig"
osource "/home/pham_vinh/Desktop/zephyr_project/zephyr/soc/intel/elkhart_lake/Kconfig.defconfig"
osource "/home/pham_vinh/Desktop/zephyr_project/zephyr/soc/intel/atom/Kconfig.defconfig"
osource "/home/pham_vinh/Desktop/zephyr_project/zephyr/soc/intel/apollo_lake/Kconfig.defconfig"
osource "/home/pham_vinh/Desktop/zephyr_project/zephyr/soc/intel/alder_lake/Kconfig.defconfig"
osource "/home/pham_vinh/Desktop/zephyr_project/zephyr/soc/infineon/cat3/Kconfig.defconfig"
osource "/home/pham_vinh/Desktop/zephyr_project/zephyr/soc/infineon/cat1b/Kconfig.defconfig"
osource "/home/pham_vinh/Desktop/zephyr_project/zephyr/soc/infineon/cat1a/Kconfig.defconfig"
osource "/home/pham_vinh/Desktop/zephyr_project/zephyr/soc/gd/gd32/Kconfig.defconfig"
osource "/home/pham_vinh/Desktop/zephyr_project/zephyr/soc/gaisler/leon3/Kconfig.defconfig"
osource "/home/pham_vinh/Desktop/zephyr_project/zephyr/soc/gaisler/gr716a/Kconfig.defconfig"
osource "/home/pham_vinh/Desktop/zephyr_project/zephyr/soc/espressif/Kconfig.defconfig"
osource "/home/pham_vinh/Desktop/zephyr_project/zephyr/soc/ene/kb1200/Kconfig.defconfig"
osource "/home/pham_vinh/Desktop/zephyr_project/zephyr/soc/efinix/sapphire/Kconfig.defconfig"
osource "/home/pham_vinh/Desktop/zephyr_project/zephyr/soc/cdns/xtensa_sample_controller/Kconfig.defconfig"
osource "/home/pham_vinh/Desktop/zephyr_project/zephyr/soc/cdns/dc233c/Kconfig.defconfig"
osource "/home/pham_vinh/Desktop/zephyr_project/zephyr/soc/brcm/bcmvk/Kconfig.defconfig"
osource "/home/pham_vinh/Desktop/zephyr_project/zephyr/soc/brcm/bcm2712/Kconfig.defconfig"
osource "/home/pham_vinh/Desktop/zephyr_project/zephyr/soc/brcm/bcm2711/Kconfig.defconfig"
osource "/home/pham_vinh/Desktop/zephyr_project/zephyr/soc/atmel/sam0/Kconfig.defconfig"
osource "/home/pham_vinh/Desktop/zephyr_project/zephyr/soc/atmel/sam/Kconfig.defconfig"
osource "/home/pham_vinh/Desktop/zephyr_project/zephyr/soc/aspeed/Kconfig.defconfig"
osource "/home/pham_vinh/Desktop/zephyr_project/zephyr/soc/arm/Kconfig.defconfig"
osource "/home/pham_vinh/Desktop/zephyr_project/zephyr/soc/arm/beetle/Kconfig.defconfig"
osource "/home/pham_vinh/Desktop/zephyr_project/zephyr/soc/andestech/Kconfig.defconfig"
osource "/home/pham_vinh/Desktop/zephyr_project/zephyr/soc/ambiq/Kconfig.defconfig"
osource "/home/pham_vinh/Desktop/zephyr_project/zephyr/soc/altr/zephyr_nios2f/Kconfig.defconfig"
osource "/home/pham_vinh/Desktop/zephyr_project/zephyr/soc/altr/qemu_nios2/Kconfig.defconfig"
osource "/home/pham_vinh/Desktop/zephyr_project/zephyr/soc/adi/max32/Kconfig.defconfig"
```
